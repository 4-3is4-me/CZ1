// (*) All in the spirit of open-source and open-hardware
// Janost 2017 Sweden
// The 3HP Paperface Euro Modules
// https://janostman.wordpress.com/the-3hp-paperface-euro-modules/
// Copyright 2017 DSP Synthesizers Sweden.
//
// Author: Jan Ostman
//
// This program is free software: you can redistribute it and/or modify
//it under the terms of the GNU General Public License as published by
// the Free Software Foundation, either version 3 of the License, or
// (at your option) any later version.
// This program is distributed in the hope that it will be useful,
// but WITHOUT ANY WARRANTY; without even the implied warranty of
// MERCHANTABILITY or FITNESS FOR A PARTICULAR PURPOSE. See the
// GNU General Public License for more details.

//Set Fuses to E1 DD FE for PLLCLK 16MHz

#include <avr/interrupt.h>

#include <avr/io.h>

#include <avr/pgmspace.h>

 

#ifndef cbi

#define cbi(sfr, bit) (_SFR_BYTE(sfr) &= ~_BV(bit))

#endif

#ifndef sbi

#define sbi(sfr, bit) (_SFR_BYTE(sfr) |= _BV(bit))

#endif

 

uint8_t phase;

uint8_t otone1;

uint8_t otone2;

 

volatile uint8_t level1;

volatile uint8_t PDmod;

 

volatile uint8_t level3;

volatile uint8_t level4;

volatile uint8_t level5;

 

uint8_t MUX;

volatile uint16_t pitch;

uint16_t phacc;

uint16_t pdacc;

uint8_t dac;

 

const uint8_t sinetable[256] PROGMEM = {

0,0,0,0,1,1,1,2,2,3,4,5,5,6,7,9,10,11,12,14,15,16,18,20,21,23,25,27,29,31,

33,35,37,39,42,44,46,49,51,54,56,59,62,64,67,70,73,76,78,81,84,87,90,93,96,99,102,105,108,111,115,118,121,124,

127,130,133,136,139,143,146,149,152,155,158,161,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240,

242,243,244,245,247,248,249,249,250,251,252,252,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223,

221,219,217,215,212,210,208,205,203,200,198,195,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78,

76,73,70,67,64,62,59,56,54,51,49,46,44,42,39,37,35,33,31,29,27,25,23,21,20,18,16,15,14,12,11,10,9,7,6,5,5,4,3,2,2,1,1,1,0,0,0

};

 

const uint16_t SAMPLEfreq[1024] PROGMEM ={

1024,1027,1030,1034,1037,1041,1045,1048,1052,1055,1059,1062,1066,1070,1073,1077,

1080,1084,1088,1092,1095,1099,1103,1106,1110,1114,1118,1121,1125,1129,1133,1137,
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31040,31145,31251,31357,31463,31570,31677,31784,31892,32000,32109,32218,32327,32436,32546,32657

};

 

 

 

void setup() {

// Enable 64 MHz PLL and use as source for Timer1

PLLCSR = 1<<PCKE | 1<<PLLE;

 

// Set up Timer/Counter1 for PWM output

TIMSK = 0; // Timer interrupts OFF

TCCR1 = 1<<PWM1A | 2<<COM1A0 | 1<<CS10; // PWM A, clear on match, 1:1 prescale

//GTCCR = 1<<PWM1B | 2<<COM1B0; // PWM B, clear on match

OCR1A = 128; //OCR1B = 128; // 50% duty at start

 

pinMode(1, OUTPUT); // Enable PWM output pin

pinMode(2, INPUT);

 

// Set up Timer/Counter0 for 66979Hz interrupt to output samples.

TCCR0A = 3<<WGM00; // Fast PWM

TCCR0B = 1<<WGM02 | 2<<CS00; // 1/8 prescale

TIMSK = 1<<OCIE0A; // Enable compare match, disable overflow

OCR0A = 29; // 66979Hz

 

uint16_t dummy=analogRead(0);

}

 

void loop() {

if (digitalRead(2)) level1=255; //Test for Gate VCA

if (!digitalRead(2)) level1=0;

 

//————— ADC block ————————————-

if (!(ADCSRA & 64)) {

uint16_t level=((ADCL+(ADCH<<8)));

if (MUX==3) pitch=(pgm_read_word_near( SAMPLEfreq + level));

if (MUX==2) PDmod=(level>>3)+1;

MUX++;

MUX&=3;

ADMUX = MUX; //Select MUX

sbi(ADCSRA, ADSC); //start next conversation

}

//—————————————————————

}

ISR(TIMER0_COMPA_vect) {

phacc+=pitch;

if (phacc & 0x8000) {

phacc &= 0x7FFF;

otone1+=1;

uint8_t env=(255-otone1);

pdacc+=PDmod;

if (!otone1) pdacc=0;

otone2=(pdacc>>3)&255;

dac=((pgm_read_byte(&sinetable[otone2])+pgm_read_byte(&sinetable[(otone2+(127-env))&255]))>>1);

OCR1A = dac&level1; //Gate the signal

}

//—————————————————————–

}
